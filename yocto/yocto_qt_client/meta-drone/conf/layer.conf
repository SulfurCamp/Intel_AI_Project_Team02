## yocto/yocto_qt_client/meta-drone/conf/layer.conf
```bitbake
BBPATH .= ":${LAYERDIR}"
BBFILES += "${LAYERDIR}/recipes-*/*/*.bb ${LAYERDIR}/recipes-*/*/*.bbappend"

BBFILE_COLLECTIONS += "drone"
BBFILE_PATTERN_drone := "^${LAYERDIR}/"
BBFILE_PRIORITY_drone = "7"

LAYERSERIES_COMPAT_drone = "kirkstone"
```

## yocto/yocto_socket_server/meta-jtylinux/conf/layer.conf
```bitbake
BBPATH .= ":${LAYERDIR}"
BBFILES += "${LAYERDIR}/recipes-*/*/*.bb \
            ${LAYERDIR}/recipes-*/*/*.bbappend"

BBFILE_COLLECTIONS += "jtylinux"
BBFILE_PATTERN_jtylinux = "^${LAYERDIR}/"
BBFILE_PRIORITY_jtylinux = "6"
LAYERSEIRIES_COMPAT_jtylinux = "kirkstone"
```
